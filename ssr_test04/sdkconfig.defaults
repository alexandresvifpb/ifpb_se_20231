## ssr_test04/sdkconfig.defaults
```kconfig
CONFIG_IDF_TARGET="esp32s2"
CONFIG_ESP_CONSOLE_USB_CDC=y
CONFIG_ESPTOOLPY_FLASHSIZE_4MB=y
CONFIG_MBEDTLS_CERTIFICATE_BUNDLE_DEFAULT_CMN=y
CONFIG_BUILD_FLAG="-D"
CONFIG_BUILD_FLAG_ESP32=-DESP32
CONFIG_BUILD_FLAG_ESP32S2=-DESP32S2
```
